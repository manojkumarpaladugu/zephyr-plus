## boards/st/nucleo_g491re/Kconfig.defconfig
```kconfig
# SPDX-License-Identifier: Apache-2.0
# Author: Manoj Kumar Paladugu <paladugumanojkumar@gmail.com>

if BOARD_NUCLEO_G491RE

config SPI_STM32_INTERRUPT
	default y
	depends on SPI

endif # BOARD_NUCLEO_G491RE
```

## boards/st/nucleo_g491re/Kconfig.nucleo_g491re
```kconfig
# SPDX-License-Identifier: Apache-2.0
# Author: Manoj Kumar Paladugu <paladugumanojkumar@gmail.com>

config BOARD_NUCLEO_G491RE
	select SOC_STM32G491XX
```

## boards/st/nucleo_g491re/nucleo_g491re_defconfig
```kconfig
# SPDX-License-Identifier: Apache-2.0
# Author: Manoj Kumar Paladugu <paladugumanojkumar@gmail.com>

# Enable UART driver
CONFIG_SERIAL=y

# Enable GPIO
CONFIG_GPIO=y

# Enable Clocks
CONFIG_CLOCK_CONTROL=y

# Enable Console
CONFIG_CONSOLE=y
CONFIG_UART_CONSOLE=y

# Enable MPU
CONFIG_ARM_MPU=y

# Enable HW Stack Protection
CONFIG_HW_STACK_PROTECTION=y

# Enable Pin Controller
CONFIG_PINCTRL=y
```
